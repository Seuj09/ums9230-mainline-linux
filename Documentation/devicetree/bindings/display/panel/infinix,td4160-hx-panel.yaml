## Documentation/devicetree/bindings/display/panel/infinix,td4160-hx-panel.yaml
```yaml
# SPDX-License-Identifier: GPL-2.0-only OR BSD-2-Clause
%YAML 1.2
---
$id: http://devicetree.org/schemas/display/panel/infinix,td4160-hx-panel.yaml#
$schema: http://devicetree.org/meta-schemas/core.yaml#

title: TD4160 HX 720x1612 MIPI-DSI LCD panel

maintainers:
  - Seuj09 <Seuj09@users.noreply.github.com>

description: |
  The TD4160 is a 720x1612 LCD panel with a MIPI-DSI interface. This variant
  ("HX", per the vendor device tree's sprd,lcm_ic_vendor) is found in the
  Infinix X6525, where the bootloader reports lcd_name
  "lcd_td4160_hx_mipi_hdp_x6525". It is a video mode DSI panel.

  Brightness is written into the panel over DCS (12-bit, register 0x51), so
  there is no backlight phandle; the driver registers the backlight itself.

allOf:
  - $ref: panel-common.yaml#

properties:
  compatible:
    const: infinix,td4160-hx-panel

  reg:
    maxItems: 1
    description: DSI virtual channel of the peripheral

  reset-gpios:
    description: |
      Panel reset. The vendor device tree drives it active-high; this is the
      first thing to check if the panel stays dark.

required:
  - compatible
  - reg
  - reset-gpios
  - port

unevaluatedProperties: false

examples:
  - |
    #include <dt-bindings/gpio/gpio.h>

    dsi {
      #address-cells = <1>;
      #size-cells = <0>;

      panel@0 {
        compatible = "infinix,td4160-hx-panel";
        reg = <0>;

        reset-gpios = <&ap_gpio 50 GPIO_ACTIVE_HIGH>;

        port {
          td4160_in: endpoint {
            remote-endpoint = <&dsi_out>;
          };
        };
      };
    };
```

## Documentation/devicetree/bindings/input/touchscreen/omnivision,tcm-spi.yaml
```yaml
# SPDX-License-Identifier: (GPL-2.0-only OR BSD-2-Clause)
%YAML 1.2
---
$id: http://devicetree.org/schemas/input/touchscreen/omnivision,tcm-spi.yaml#
$schema: http://devicetree.org/meta-schemas/core.yaml#

title: OmniVision TCM touchscreen controller (SPI, host firmware download)

maintainers:
  - Seuj09 <jeus110310@gmail.com>

description: |
  Touch controller of the TD4160 touch/display IC. It has no flash: after each
  reset the host downloads the application firmware and its configuration from
  an image file.

allOf:
  - $ref: /schemas/spi/spi-peripheral-props.yaml#

properties:
  compatible:
    const: omnivision,tcm-spi

  reg:
    maxItems: 1

  # SPI mode 3. spi-peripheral-props.yaml does not cover these two, so a
  # peripheral that needs them declares them, as e.g. samsung,ld9040.yaml does.
  spi-cpha: true
  spi-cpol: true

  interrupts:
    maxItems: 1

  reset-gpios:
    maxItems: 1
    description: |
      Reset line. The controller is held in reset while it is asserted: the
      vendor device tree drives it low for 20 ms and then releases it, so the
      line is active-low.

  firmware-name:
    description: HDL image requested through request_firmware().

required:
  - compatible
  - reg
  - interrupts
  - reset-gpios
  - firmware-name

unevaluatedProperties: false

examples:
  - |
    #include <dt-bindings/gpio/gpio.h>
    #include <dt-bindings/interrupt-controller/irq.h>
    spi {
        #address-cells = <1>;
        #size-cells = <0>;
        touchscreen@0 {
            compatible = "omnivision,tcm-spi";
            reg = <0>;
            spi-max-frequency = <8000000>;
            spi-cpha;
            spi-cpol;
            interrupts-extended = <&gpio 16 IRQ_TYPE_LEVEL_LOW>;
            reset-gpios = <&gpio 145 GPIO_ACTIVE_LOW>;
            firmware-name = "postmarketos/sprd/hdl_firmware_01.img";
        };
    };
...
```

## Documentation/devicetree/bindings/power/supply/linux,extcon-charger-detect.yaml
```yaml
# SPDX-License-Identifier: GPL-2.0-only OR BSD-2-Clause
%YAML 1.2
---
$id: http://devicetree.org/schemas/power/supply/linux,extcon-charger-detect.yaml#
$schema: http://devicetree.org/meta-schemas/core.yaml#

title: USB charger power supply backed by an extcon

maintainers:
  - Seuj09 <jeus110310@gmail.com>

description:
  Reports what an extcon device sees (VBUS, or the BC1.2 charger types) as a
  USB power supply with a current limit. Chargers that follow such a supply,
  like the TI bq2415x through ti,usb-charger-detection, use it to pick their
  input current.

properties:
  compatible:
    const: linux,extcon-charger-detect

  extcon:
    $ref: /schemas/types.yaml#/definitions/phandle
    description: extcon device to follow.

  default-microamp:
    description: Limit for a standard downstream port or a plain VBUS extcon.
    default: 500000

  cdp-microamp:
    description: Limit for a charging downstream port.
    default: 1500000

  dedicated-charger-microamp:
    description: Limit for a dedicated charger.
    default: 2000000

required:
  - compatible
  - extcon

additionalProperties: false

examples:
  - |
    usb-charger-detect {
        compatible = "linux,extcon-charger-detect";
        extcon = <&vbus_extcon>;
    };
...
```
